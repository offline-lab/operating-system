## br2-external/Config.in
```kconfig
################################################################################
#         ____  ___________               __          __                       #
#        / __ \/ __/ __/ (_)___  ___     / /   ____ _/ /_                      #
#       / / / / /_/ /_/ / / __ \/ _ \   / /   / __ `/ __ \                     #
#      / /_/ / __/ __/ / / / / /  __/  / /___/ /_/ / /_/ /                     #
#      \____/_/ /_/ /_/_/_/ /_/\___/  /_____/\__,_/_.___/                      #
#                                                                              #
#      Copyright (C) 2025-2026 Offline Lab                                     #
#      Contact: info@offline-lab.com                                           #
#      SPDX-License-Identifier: AGPL-3.0-only                                  #
################################################################################

menu "Offline Lab board options"
	source "$BR2_EXTERNAL_OFFLINELAB_PATH/boards/pi-zero-2w/Config.in"
	source "$BR2_EXTERNAL_OFFLINELAB_PATH/package/offlinelab-base/Config.in"
	source "$BR2_EXTERNAL_OFFLINELAB_PATH/package/offlinelab-usb-gadget/Config.in"
	source "$BR2_EXTERNAL_OFFLINELAB_PATH/package/offlinelab-wifi/Config.in"
	source "$BR2_EXTERNAL_OFFLINELAB_PATH/package/offlinelab-ssh/Config.in"
	source "$BR2_EXTERNAL_OFFLINELAB_PATH/package/offlinelab-zram/Config.in"
	source "$BR2_EXTERNAL_OFFLINELAB_PATH/package/offlinelab-update/Config.in"
	source "$BR2_EXTERNAL_OFFLINELAB_PATH/package/offlinelab-disco/Config.in"
	source "$BR2_EXTERNAL_OFFLINELAB_PATH/package/offlinelab-portable/Config.in"
endmenu
```

## br2-external/boards/pi-zero-2w/Config.in
```kconfig
config BR2_PACKAGE_BOARD_PI_ZERO_2W
	bool "Raspberry Pi Zero 2W board support"
	select BR2_PACKAGE_RPI_FIRMWARE
	help
	  Offline Lab board support for Raspberry Pi Zero 2W
```

## br2-external/boards/rpi/pi-zero-2w/Config.in
```kconfig
################################################################################
#         ____  ___________               __          __                       #
#        / __ \/ __/ __/ (_)___  ___     / /   ____ _/ /_                      #
#       / / / / /_/ /_/ / / __ \/ _ \   / /   / __ `/ __ \                     #
#      / /_/ / __/ __/ / / / / /  __/  / /___/ /_/ / /_/ /                     #
#      \____/_/ /_/ /_/_/_/ /_/\___/  /_____/\__,_/_.___/                      #
#                                                                              #
#      Copyright (C) 2025-2026 Offline Lab                                     #
#      Contact: info@offline-lab.com                                           #
#      SPDX-License-Identifier: AGPL-3.0-only                                  #
################################################################################

config BR2_PACKAGE_BOARD_PI_ZERO_2W
	bool "Raspberry Pi Zero 2W board support"
	select BR2_PACKAGE_RPI_FIRMWARE
	help
	  Offline Lab board support for Raspberry Pi Zero 2W
```

## br2-external/boards/rpi/rpi3/Config.in
```kconfig
################################################################################
#         ____  ___________               __          __                       #
#        / __ \/ __/ __/ (_)___  ___     / /   ____ _/ /_                      #
#       / / / / /_/ /_/ / / __ \/ _ \   / /   / __ `/ __ \                     #
#      / /_/ / __/ __/ / / / / /  __/  / /___/ /_/ / /_/ /                     #
#      \____/_/ /_/ /_/_/_/ /_/\___/  /_____/\__,_/_.___/                      #
#                                                                              #
#      Copyright (C) 2025-2026 Offline Lab                                     #
#      Contact: info@offline-lab.com                                           #
#      SPDX-License-Identifier: AGPL-3.0-only                                  #
################################################################################

config BR2_PACKAGE_BOARD_RPI3
	bool "Raspberry Pi 3B+ board support"
	select BR2_PACKAGE_RPI_FIRMWARE
	help
	  Offline Lab board support for Raspberry Pi 3B+
```

## br2-external/configs/offlinelab_common_defconfig
```kconfig
################################################################################
#         ____  ___________               __          __                       #
#        / __ \/ __/ __/ (_)___  ___     / /   ____ _/ /_                      #
#       / / / / /_/ /_/ / / __ \/ _ \   / /   / __ `/ __ \                     #
#      / /_/ / __/ __/ / / / / /  __/  / /___/ /_/ / /_/ /                     #
#      \____/_/ /_/ /_/_/_/ /_/\___/  /_____/\__,_/_.___/                      #
#                                                                              #
#      Copyright (C) 2025-2026 Offline Lab                                     #
#      Contact: info@offline-lab.com                                           #
#      SPDX-License-Identifier: AGPL-3.0-only                                  #
################################################################################

# Common base defconfig — shared by all Offline Lab OS boards.
# Board-specific settings (CPU, kernel source, U-Boot target, firmware,
# getty port, post-script args) live in each board's own defconfig, which
# build-image.sh merges on top of this file via merge_config.sh.

# Ccache
BR2_CCACHE=y
BR2_CCACHE_DIR="/buildroot/.ccache"

# Patches
BR2_GLOBAL_PATCH_DIR="$(BR2_EXTERNAL_OFFLINELAB_PATH)/patches"

# Reproducible builds
BR2_REPRODUCIBLE=y

# Architecture — all supported boards are aarch64; CPU subtype set per board
BR2_aarch64=y

# Toolchain
BR2_USE_WCHAR=y
BR2_TOOLCHAIN_BUILDROOT_CXX=y
BR2_KERNEL_HEADERS_6_12=y

# Kernel — common flags; source, defconfig, and DTS set per board
BR2_LINUX_KERNEL=y
BR2_LINUX_KERNEL_NEEDS_HOST_OPENSSL=y
BR2_LINUX_KERNEL_INSTALL_TARGET=y

# U-Boot — common flags; board defconfig and fragments set per board
BR2_TARGET_UBOOT=y
BR2_TARGET_UBOOT_BUILD_SYSTEM_KCONFIG=y
BR2_TARGET_UBOOT_FORMAT_BIN=y
BR2_TARGET_UBOOT_NEEDS_DTC=y

# System
BR2_SYSTEM_BIN_SH_BASH=y
BR2_SYSTEM_DEFAULT_PATH="/usr/local/bin:/usr/local/sbin:/bin:/sbin:/usr/bin:/usr/sbin"
BR2_TARGET_ENABLE_ROOT_LOGIN=n
BR2_TARGET_GENERIC_ROOT_PASSWD="*"
BR2_TARGET_GENERIC_ISSUE=""
BR2_TARGET_GENERIC_HOSTNAME="offlinelab"

# Filesystem
BR2_TARGET_ROOTFS_SQUASHFS=y
BR2_TARGET_ROOTFS_SQUASHFS4_COMPRESSION_ALGO_LZ4=y
BR2_ROOTFS_MERGED_USR=y
BR2_ROOTFS_DEVICE_TABLE_SUPPORTS_EXTENDED_ATTRIBUTES=y

# Scripts, skeleton, overlay — post-script args set per board
BR2_ROOTFS_POST_BUILD_SCRIPT="$(BR2_EXTERNAL_OFFLINELAB_PATH)/boards/scripts/post-build.sh"
BR2_ROOTFS_POST_IMAGE_SCRIPT="$(BR2_EXTERNAL_OFFLINELAB_PATH)/boards/scripts/post-image.sh"
BR2_ROOTFS_SKELETON_CUSTOM=y
BR2_ROOTFS_SKELETON_CUSTOM_PATH="$(BR2_EXTERNAL_OFFLINELAB_PATH)/skeleton"
BR2_ROOTFS_DEVICE_TABLE="$(BR2_EXTERNAL_OFFLINELAB_PATH)/devices.txt"
BR2_ROOTFS_OVERLAY="$(BR2_EXTERNAL_OFFLINELAB_PATH)/rootfs_overlay"

# Init: systemd
BR2_INIT_SYSTEMD=y
BR2_PACKAGE_SYSTEMD=y
BR2_PACKAGE_SYSTEMD_COREDUMP=y
BR2_PACKAGE_SYSTEMD_NETWORKD=y
# BR2_PACKAGE_SYSTEMD_RESOLVED is not set
# BR2_PACKAGE_SYSTEMD_TIMESYNCD is not set
BR2_PACKAGE_SYSTEMD_PORTABLED=y
BR2_PACKAGE_SYSTEMD_SYSEXT=y
BR2_PACKAGE_SYSTEMD_SYSUSERS=y
BR2_PACKAGE_SYSTEMD_TMPFILES=y
BR2_PACKAGE_SYSTEMD_NSPAWN=y
BR2_PACKAGE_SYSTEMD_REPART=y
BR2_PACKAGE_DBUS=y

# Busybox (static for initramfs)
BR2_PACKAGE_BUSYBOX=y
BR2_PACKAGE_BUSYBOX_SHOW_OTHERS=y
BR2_PACKAGE_BUSYBOX_CONFIG_FRAGMENT_FILES="$(BR2_EXTERNAL_OFFLINELAB_PATH)/boards/common/fragments/busybox.config"

# Packages
BR2_PACKAGE_E2FSPROGS=y
BR2_PACKAGE_KMOD=y
BR2_PACKAGE_KMOD_TOOLS=y
BR2_PACKAGE_XZ=y
BR2_PACKAGE_PARTED=y
BR2_PACKAGE_SUDO=y
BR2_PACKAGE_UTIL_LINUX=y
BR2_PACKAGE_UTIL_LINUX_BINARIES=y
BR2_PACKAGE_UTIL_LINUX_NOLOGIN=y
BR2_PACKAGE_UTIL_LINUX_RFKILL=y
BR2_PACKAGE_UTIL_LINUX_ZRAMCTL=y
BR2_PACKAGE_WPA_SUPPLICANT=y
BR2_PACKAGE_WPA_SUPPLICANT_CLI=y
BR2_PACKAGE_CA_CERTIFICATES=y
BR2_PACKAGE_IW=y
BR2_PACKAGE_DTC=y
BR2_PACKAGE_DTC_PROGRAMS=y

# Host tools for image creation
BR2_PACKAGE_HOST_E2FSPROGS=y
BR2_PACKAGE_HOST_DOSFSTOOLS=y
BR2_PACKAGE_HOST_MTOOLS=y
BR2_PACKAGE_HOST_GENIMAGE=y
BR2_PACKAGE_HOST_DTC=y
BR2_PACKAGE_HOST_KMOD_XZ=y
BR2_PACKAGE_HOST_UBOOT_TOOLS=y
BR2_PACKAGE_HOST_SQUASHFS=y

# Board packages
BR2_PACKAGE_OFFLINELAB_BASE=y
BR2_PACKAGE_OFFLINELAB_BOOTCONF=y
BR2_PACKAGE_SHADOW=y
BR2_PACKAGE_OFFLINELAB_FRAMEWORK=y
BR2_PACKAGE_NFTABLES=y
BR2_PACKAGE_OFFLINELAB_FIREWALL=y
BR2_PACKAGE_OFFLINELAB_WIFI=y
BR2_PACKAGE_OFFLINELAB_SSH=y
BR2_PACKAGE_OFFLINELAB_ZRAM=y
BR2_PACKAGE_OFFLINELAB_UPDATE=y
BR2_PACKAGE_OFFLINELAB_DISCO=y
BR2_PACKAGE_OFFLINELAB_PORTABLE=y

# Splash screen
BR2_PACKAGE_PSPLASH=y
BR2_PACKAGE_PSPLASH_IMAGE="$(BR2_EXTERNAL_OFFLINELAB_PATH)/boards/common/splash.png"
BR2_PACKAGE_PSPLASH_FULL_SCREEN=y

# RAUC A/B updates
BR2_PACKAGE_RAUC=y
BR2_PACKAGE_RAUC_DBUS=y
BR2_PACKAGE_HOST_RAUC=y
BR2_PACKAGE_UBOOT_TOOLS=y
BR2_PACKAGE_UBOOT_TOOLS_FWPRINTENV=y

# AppArmor userspace (kernel LSM already built-in)
BR2_PACKAGE_APPARMOR=y
BR2_PACKAGE_APPARMOR_BINUTILS=y
BR2_PACKAGE_OFFLINELAB_RESOURCES=y
```

## br2-external/configs/offlinelab_pi_zero_2w_defconfig
```kconfig
################################################################################
#         ____  ___________               __          __                       #
#        / __ \/ __/ __/ (_)___  ___     / /   ____ _/ /_                      #
#       / / / / /_/ /_/ / / __ \/ _ \   / /   / __ `/ __ \                     #
#      / /_/ / __/ __/ / / / / /  __/  / /___/ /_/ / /_/ /                     #
#      \____/_/ /_/ /_/_/_/ /_/\___/  /_____/\__,_/_.___/                      #
#                                                                              #
#      Copyright (C) 2025-2026 Offline Lab                                     #
#      Contact: info@offline-lab.com                                           #
#      SPDX-License-Identifier: AGPL-3.0-only                                  #
################################################################################

# Board fragment — merged on top of offlinelab_common_defconfig by build-image.sh.
# Only board-specific settings live here.

# Architecture — Cortex-A53, VFPv4 FPU
BR2_cortex_a53=y
BR2_ARM_FPU_VFPV4=y

# Kernel — RPi vendor kernel; bcm2711_defconfig + OS fragment + RPi hardware fragment
BR2_LINUX_KERNEL_CUSTOM_TARBALL=y
BR2_LINUX_KERNEL_CUSTOM_TARBALL_LOCATION="https://github.com/raspberrypi/linux/archive/refs/tags/rpi-6.12.y_20241206_2.tar.gz"
BR2_LINUX_KERNEL_USE_DEFCONFIG=y
BR2_LINUX_KERNEL_DEFCONFIG="bcm2711"
BR2_LINUX_KERNEL_CONFIG_FRAGMENT_FILES="$(BR2_EXTERNAL_OFFLINELAB_PATH)/boards/common/fragments/linux-kernel.config $(BR2_EXTERNAL_OFFLINELAB_PATH)/boards/rpi/fragments/linux-hardware.config"
BR2_LINUX_KERNEL_DTS_SUPPORT=y
BR2_LINUX_KERNEL_INTREE_DTS_NAME="broadcom/bcm2710-rpi-zero-2-w"

# U-Boot (rpi_arm64 = aarch64 for BCM2710/Pi Zero 2W)
BR2_TARGET_UBOOT_BOARD_DEFCONFIG="rpi_arm64"
BR2_TARGET_UBOOT_CONFIG_FRAGMENT_FILES="$(BR2_EXTERNAL_OFFLINELAB_PATH)/boards/rpi/pi-zero-2w/fragments/uboot-fragment.config"

# RPi firmware
BR2_PACKAGE_RPI_FIRMWARE=y
BR2_PACKAGE_RPI_FIRMWARE_CONFIG_FILE="$(BR2_EXTERNAL_OFFLINELAB_PATH)/boards/rpi/pi-zero-2w/config.txt"
BR2_PACKAGE_RPI_FIRMWARE_CMDLINE_FILE="$(BR2_EXTERNAL_OFFLINELAB_PATH)/boards/rpi/pi-zero-2w/cmdline.txt"
BR2_PACKAGE_RPI_FIRMWARE_INSTALL_DTB_OVERLAYS=y
BR2_PACKAGE_RPI_FIRMWARE_BOOTCODE_BIN=y
BR2_PACKAGE_RPI_FIRMWARE_VARIANT_PI=y

# WiFi + BT firmware
BR2_PACKAGE_BRCMFMAC_SDIO_FIRMWARE_RPI=y
BR2_PACKAGE_BRCMFMAC_SDIO_FIRMWARE_RPI_WIFI=y
BR2_PACKAGE_BRCMFMAC_SDIO_FIRMWARE_RPI_BT=y

# System
BR2_TARGET_GENERIC_GETTY_PORT="ttyS0"

# Post-image scripts
BR2_ROOTFS_POST_SCRIPT_ARGS="$(BR2_EXTERNAL_OFFLINELAB_PATH)/boards/rpi/pi-zero-2w $(BR2_EXTERNAL_OFFLINELAB_PATH)/boards/rpi/hook.sh"

# USB gadget (OTG port)
BR2_PACKAGE_OFFLINELAB_USB_GADGET=y
```

## br2-external/configs/offlinelab_qemu_arm64_defconfig
```kconfig
################################################################################
#         ____  ___________               __          __                       #
#        / __ \/ __/ __/ (_)___  ___     / /   ____ _/ /_                      #
#       / / / / /_/ /_/ / / __ \/ _ \   / /   / __ `/ __ \                     #
#      / /_/ / __/ __/ / / / / /  __/  / /___/ /_/ / /_/ /                     #
#      \____/_/ /_/ /_/_/_/ /_/\___/  /_____/\__,_/_.___/                      #
#                                                                              #
#      Copyright (C) 2025-2026 Offline Lab                                     #
#      Contact: info@offline-lab.com                                           #
#      SPDX-License-Identifier: AGPL-3.0-only                                  #
################################################################################

# Board fragment — merged on top of offlinelab_common_defconfig by build-image.sh.
# Only board-specific settings live here.

# Architecture — Cortex-A53 aarch64, VFPv4 FPU (matches pi-zero-2w for toolchain reuse)
BR2_cortex_a53=y
BR2_ARM_FPU_VFPV4=y

# Kernel — mainline latest; arm64 defconfig + OS fragment + QEMU hardware fragment
BR2_LINUX_KERNEL_LATEST_VERSION=y
BR2_LINUX_KERNEL_USE_CUSTOM_CONFIG=y
BR2_LINUX_KERNEL_CUSTOM_CONFIG_FILE="$(LINUX_DIR)/arch/arm64/configs/defconfig"
BR2_LINUX_KERNEL_CONFIG_FRAGMENT_FILES="$(BR2_EXTERNAL_OFFLINELAB_PATH)/boards/common/fragments/linux-kernel.config $(BR2_EXTERNAL_OFFLINELAB_PATH)/boards/qemu/arm64/fragments/linux-hardware.config"

# U-Boot — qemu_arm64 defconfig; no RPi firmware dependency
BR2_TARGET_UBOOT_BOARD_DEFCONFIG="qemu_arm64"
BR2_TARGET_UBOOT_CONFIG_FRAGMENT_FILES="$(BR2_EXTERNAL_OFFLINELAB_PATH)/boards/qemu/arm64/fragments/uboot-fragment.config"

# System
BR2_TARGET_GENERIC_GETTY_PORT="ttyAMA0"

# Post-image scripts
BR2_ROOTFS_POST_SCRIPT_ARGS="$(BR2_EXTERNAL_OFFLINELAB_PATH)/boards/qemu/arm64 $(BR2_EXTERNAL_OFFLINELAB_PATH)/boards/qemu/hook.sh"

# USB gadget (emulated; wifi/usb-gadget services fail gracefully without hardware)
BR2_PACKAGE_OFFLINELAB_USB_GADGET=y

# Testing — select board-specific bootconf template (no WiFi for QEMU)
BR2_PACKAGE_OFFLINELAB_TESTING_BOARD="qemu-arm64"
```

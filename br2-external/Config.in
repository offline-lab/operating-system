## br2-external/package/offlinelab-framework/Config.in
```kconfig
################################################################################
#         ____  ___________               __          __                       #
#        / __ \/ __/ __/ (_)___  ___     / /   ____ _/ /_                      #
#       / / / / /_/ /_/ / / __ \/ _ \   / /   / __ `/ __ \                     #
#      / /_/ / __/ __/ / / / / /  __/  / /___/ /_/ / /_/ /                     #
#      \____/_/ /_/ /_/_/_/ /_/\___/  /_____/\__,_/_.___/                      #
#                                                                              #
#      Copyright (C) 2025-2026 Offline Lab                                     #
#      Contact: info@offline-lab.com                                           #
#      SPDX-License-Identifier: AGPL-3.0-only                                  #
################################################################################

config BR2_PACKAGE_OFFLINELAB_FRAMEWORK_VERSION
	string "offlinelab-framework version (git tag or commit)"
	default "e0fe1d6651ce57d885923f3884a107a2b5134819"
	help
	  Git tag or commit hash to fetch from github.com/offline-lab/framework.

config BR2_PACKAGE_OFFLINELAB_FRAMEWORK
	bool "offlinelab-framework"
	default y
	depends on BR2_PACKAGE_OFFLINELAB_BASE
	select BR2_PACKAGE_FILE
	select BR2_PACKAGE_JQ
	select BR2_PACKAGE_NCURSES
	select BR2_PACKAGE_LIBCURL
	select BR2_PACKAGE_LIBCURL_CURL
	select BR2_PACKAGE_RAUC
	select BR2_PACKAGE_WPA_SUPPLICANT
	select BR2_PACKAGE_IPROUTE2
	select BR2_PACKAGE_FZF
	select BR2_PACKAGE_DROPBEAR
	select BR2_PACKAGE_OPENSSL
	help
	  Bash utility library and system management CLI for Offline Lab OS.
	  Fetched from github.com/offline-lab/offline-lab-framework at build time.
	  Installs library modules to /usr/lib/framework/ and boxctl + subcommands
	  to /usr/lib/framework/bin/ (added to PATH via /etc/profile.d/framework.sh).
```

## br2-external/package/offlinelab-portable/Config.in
```kconfig
################################################################################
#         ____  ___________               __          __                       #
#        / __ \/ __/ __/ (_)___  ___     / /   ____ _/ /_                      #
#       / / / / /_/ /_/ / / __ \/ _ \   / /   / __ `/ __ \                     #
#      / /_/ / __/ __/ / / / / /  __/  / /___/ /_/ / /_/ /                     #
#      \____/_/ /_/ /_/_/_/ /_/\___/  /_____/\__,_/_.___/                      #
#                                                                              #
#      Copyright (C) 2025-2026 Offline Lab                                     #
#      Contact: info@offline-lab.com                                           #
#      SPDX-License-Identifier: AGPL-3.0-only                                  #
################################################################################

config BR2_PACKAGE_OFFLINELAB_PORTABLE
	bool "offlinelab-portable"
	default y
	depends on BR2_INIT_SYSTEMD
	select BR2_PACKAGE_SYSTEMD_PORTABLED
	select BR2_PACKAGE_SYSTEMD_SYSEXT
	help
	  Portable services, system extensions, and config extensions
	  infrastructure for Offline Lab OS.

	  Enables systemd-portabled, systemd-sysext, and
	  systemd-confext with image stores on /data.
```

## br2-external/package/offlinelab-resources/Config.in
```kconfig
################################################################################
#         ____  ___________               __          __                       #
#        / __ \/ __/ __/ (_)___  ___     / /   ____ _/ /_                      #
#       / / / / /_/ /_/ / / __ \/ _ \   / /   / __ `/ __ \                     #
#      / /_/ / __/ __/ / / / / /  __/  / /___/ /_/ / /_/ /                     #
#      \____/_/ /_/ /_/_/_/ /_/\___/  /_____/\__,_/_.___/                      #
#                                                                              #
#      Copyright (C) 2025-2026 Offline Lab                                     #
#      Contact: info@offline-lab.com                                           #
#      SPDX-License-Identifier: AGPL-3.0-only                                  #
################################################################################

config BR2_PACKAGE_OFFLINELAB_RESOURCES
	bool "offlinelab-resources"
	select BR2_PACKAGE_JQ
	help
	  Measures OS resource baseline at boot and writes
	  /data/config/resources.json for appctl install-time checks.
	  Measures total RAM, CPU cores, /data storage, and baseline
	  memory and CPU usage sampled over 5 seconds.
```

## br2-external/package/offlinelab-ssh/Config.in
```kconfig
################################################################################
#         ____  ___________               __          __                       #
#        / __ \/ __/ __/ (_)___  ___     / /   ____ _/ /_                      #
#       / / / / /_/ /_/ / / __ \/ _ \   / /   / __ `/ __ \                     #
#      / /_/ / __/ __/ / / / / /  __/  / /___/ /_/ / /_/ /                     #
#      \____/_/ /_/ /_/_/_/ /_/\___/  /_____/\__,_/_.___/                      #
#                                                                              #
#      Copyright (C) 2025-2026 Offline Lab                                     #
#      Contact: info@offline-lab.com                                           #
#      SPDX-License-Identifier: AGPL-3.0-only                                  #
################################################################################

config BR2_PACKAGE_OFFLINELAB_SSH
	bool "offlinelab-ssh"
	default y
	depends on BR2_INIT_SYSTEMD
	select BR2_PACKAGE_DROPBEAR
	help
	  SSH server using dropbear with key-only authentication.
	  Host key generated by bootconf at /data/config/ssh/hostkey.
	  Service starts only when /data/config/services/ssh sentinel exists.
```

## br2-external/package/offlinelab-testing/Config.in
```kconfig
################################################################################
#         ____  ___________               __          __                       #
#        / __ \/ __/ __/ (_)___  ___     / /   ____ `/ /_                      #
#       / / / / /_/ /_/ / / __ \/ _ \   / /   / __ `/ __ \                     #
#      / /_/ / __/ __/ / / / / /  __/  / /___/ /_/ / /_/ /                     #
#      \____/_/ /_/ /_/_/_/ /_/\___/  /_____/\__,_/_.___/                      #
#                                                                              #
#      Copyright (C) 2025-2026 Offline Lab                                     #
#      Contact: info@offline-lab.com                                           #
#      SPDX-License-Identifier: AGPL-3.0-only                                  #
################################################################################

config BR2_PACKAGE_OFFLINELAB_TESTING
	bool "offlinelab-testing (dev/test users and credentials)"
	depends on BR2_INIT_SYSTEMD
	depends on BR2_PACKAGE_OFFLINELAB_BASE
	default n
	help
	  Installs development and test user credentials into the image:

	    admin (uid 1000)    — SSH key, sudo, home dir, admin-bin PATH
	    testuser (uid 1001) — SSH key, passwordless sudo, home dir

	  Both users share the same authorized SSH key. testuser is
	  intended for the operating-system-infra-test suite.

	  Do NOT enable on production builds.

if BR2_PACKAGE_OFFLINELAB_TESTING

config BR2_PACKAGE_OFFLINELAB_TESTING_BOARD
	string "Board name for bootconf template selection"
	default ""
	help
	  Used to select a board-specific bootconf template from the testing
	  package source: bootconf-<board>.yaml. Falls back to bootconf.yaml
	  if no board-specific template exists.
	  Set this in the board defconfig, e.g. "qemu-arm64".

config BR2_PACKAGE_OFFLINELAB_TESTING_ADMIN_PUBKEY
	string "SSH authorized public key for admin user"
	default ""
	help
	  Installed to /home/admin/.ssh/authorized_keys at build time.
	  Set this in .config (gitignored) — do not commit personal keys.

config BR2_PACKAGE_OFFLINELAB_TESTING_TESTUSER_PUBKEY
	string "SSH authorized public key for testuser"
	default ""
	help
	  Installed to /home/testuser/.ssh/authorized_keys at build time.
	  Also substituted into bootconf-<board>.yaml as @@TESTUSER_PUBKEY@@.
	  Set this in .config (gitignored) — do not commit personal keys.

config BR2_PACKAGE_OFFLINELAB_TESTING_WIFI_SSID
	string "WiFi SSID (baked into bootconf.yaml)"
	default ""
	help
	  Pre-fills the WiFi SSID in bootconf.yaml placed on /boot/firmware.
	  When set, wifi.enabled is set to true in bootconf.yaml automatically.
	  Set this in .config (gitignored) — do not commit network credentials.

config BR2_PACKAGE_OFFLINELAB_TESTING_WIFI_PASSWORD_HASH
	string "WiFi password hash (from wpa_passphrase)"
	default ""
	help
	  PSK hash from wpa_passphrase output, not the plaintext password.
	  Example: wpa_passphrase MyNetwork MyPassphrase | grep psk=

config BR2_PACKAGE_OFFLINELAB_TESTING_WIFI_COUNTRY
	string "WiFi regulatory country code"
	default "NL"
	help
	  ISO 3166-1 alpha-2 country code (e.g. NL, US, GB, DE).

endif
```

## br2-external/package/offlinelab-update/Config.in
```kconfig
################################################################################
#         ____  ___________               __          __                       #
#        / __ \/ __/ __/ (_)___  ___     / /   ____ _/ /_                      #
#       / / / / /_/ /_/ / / __ \/ _ \   / /   / __ `/ __ \                     #
#      / /_/ / __/ __/ / / / / /  __/  / /___/ /_/ / /_/ /                     #
#      \____/_/ /_/ /_/_/_/ /_/\___/  /_____/\__,_/_.___/                      #
#                                                                              #
#      Copyright (C) 2025-2026 Offline Lab                                     #
#      Contact: info@offline-lab.com                                           #
#      SPDX-License-Identifier: AGPL-3.0-only                                  #
################################################################################

config BR2_PACKAGE_OFFLINELAB_UPDATE
	bool "offlinelab-update"
	default y
	depends on BR2_INIT_SYSTEMD
	select BR2_PACKAGE_RAUC
	select BR2_PACKAGE_RAUC_DBUS
	select BR2_PACKAGE_UBOOT_TOOLS
	select BR2_PACKAGE_UBOOT_TOOLS_FWPRINTENV
	help
	  RAUC A/B update integration for Offline Lab OS.
	  Installs system.conf, keyring, fw_env.config,
	  and mark-good service.

if BR2_PACKAGE_OFFLINELAB_UPDATE

config BR2_PACKAGE_OFFLINELAB_UPDATE_KEYRING
	string "Path to RAUC CA certificate (keyring.pem)"
	default "$(BR2_EXTERNAL_OFFLINELAB_PATH)/../.rauc/ca.cert.pem"
	help
	  Absolute or BR2_EXTERNAL_OFFLINELAB_PATH-relative path to the RAUC
	  signing CA certificate installed as /etc/rauc/keyring.pem.

	  Default expects the certificate at .rauc/ca.cert.pem one level above
	  the br2-external directory. Override this if your key material lives
	  elsewhere (CI secret mount, separate repo, etc.).

endif
```

## br2-external/package/offlinelab-usb-gadget/Config.in
```kconfig
################################################################################
#         ____  ___________               __          __                       #
#        / __ \/ __/ __/ (_)___  ___     / /   ____ _/ /_                      #
#       / / / / /_/ /_/ / / __ \/ _ \   / /   / __ `/ __ \                     #
#      / /_/ / __/ __/ / / / / /  __/  / /___/ /_/ / /_/ /                     #
#      \____/_/ /_/ /_/_/_/ /_/\___/  /_____/\__,_/_.___/                      #
#                                                                              #
#      Copyright (C) 2025-2026 Offline Lab                                     #
#      Contact: info@offline-lab.com                                           #
#      SPDX-License-Identifier: AGPL-3.0-only                                  #
################################################################################

config BR2_PACKAGE_OFFLINELAB_USB_GADGET
	bool "offlinelab-usb-gadget"
	default y
	depends on BR2_INIT_SYSTEMD
	select BR2_PACKAGE_SYSTEMD_NETWORKD
	help
	  USB composite gadget (ACM serial + ECM ethernet).
	  Provides serial console on ttyGS0 and ethernet on usb0
	  when connected to a host via USB.
```

## br2-external/package/offlinelab-wifi/Config.in
```kconfig
################################################################################
#         ____  ___________               __          __                       #
#        / __ \/ __/ __/ (_)___  ___     / /   ____ _/ /_                      #
#       / / / / /_/ /_/ / / __ \/ _ \   / /   / __ `/ __ \                     #
#      / /_/ / __/ __/ / / / / /  __/  / /___/ /_/ / /_/ /                     #
#      \____/_/ /_/ /_/_/_/ /_/\___/  /_____/\__,_/_.___/                      #
#                                                                              #
#      Copyright (C) 2025-2026 Offline Lab                                     #
#      Contact: info@offline-lab.com                                           #
#      SPDX-License-Identifier: AGPL-3.0-only                                  #
################################################################################

config BR2_PACKAGE_OFFLINELAB_WIFI
	bool "offlinelab-wifi"
	default y
	depends on BR2_INIT_SYSTEMD
	select BR2_PACKAGE_WPA_SUPPLICANT
	select BR2_PACKAGE_IW
	select BR2_PACKAGE_UTIL_LINUX
	select BR2_PACKAGE_UTIL_LINUX_RFKILL
	help
	  WiFi support with wpa_supplicant.
	  Config generated by bootconf from /boot/firmware/bootconf.yaml.
	  Service starts only when /data/config/services/wifi sentinel exists.
```

## br2-external/package/offlinelab-zram/Config.in
```kconfig
config BR2_PACKAGE_OFFLINELAB_ZRAM
	bool "offlinelab-zram"
	default y
	depends on BR2_INIT_SYSTEMD
	select BR2_PACKAGE_UTIL_LINUX
	select BR2_PACKAGE_UTIL_LINUX_ZRAMCTL
	help
	  zram swap for low-memory operation.
	  Configures compressed RAM-based swap on boot.
```

## br2-external/configs/offlinelab_rpi3_defconfig
```kconfig
################################################################################
#         ____  ___________               __          __                       #
#        / __ \/ __/ __/ (_)___  ___     / /   ____ _/ /_                      #
#       / / / / /_/ /_/ / / __ \/ _ \   / /   / __ `/ __ \                     #
#      / /_/ / __/ __/ / / / / /  __/  / /___/ /_/ / /_/ /                     #
#      \____/_/ /_/ /_/_/_/ /_/\___/  /_____/\__,_/_.___/                      #
#                                                                              #
#      Copyright (C) 2025-2026 Offline Lab                                     #
#      Contact: info@offline-lab.com                                           #
#      SPDX-License-Identifier: AGPL-3.0-only                                  #
################################################################################

# Board fragment — merged on top of offlinelab_common_defconfig by build-image.sh.
# Only board-specific settings live here.

# Architecture — Cortex-A53 aarch64 (BCM2837; no VFPv4 override needed)
BR2_cortex_a53=y

# Kernel — RPi vendor kernel; bcm2711_defconfig covers Pi 3 family
BR2_LINUX_KERNEL_CUSTOM_TARBALL=y
BR2_LINUX_KERNEL_CUSTOM_TARBALL_LOCATION="https://github.com/raspberrypi/linux/archive/refs/tags/rpi-6.12.y_20241206_2.tar.gz"
BR2_LINUX_KERNEL_USE_DEFCONFIG=y
BR2_LINUX_KERNEL_DEFCONFIG="bcm2711"
BR2_LINUX_KERNEL_CONFIG_FRAGMENT_FILES="$(BR2_EXTERNAL_OFFLINELAB_PATH)/boards/common/fragments/linux-kernel.config $(BR2_EXTERNAL_OFFLINELAB_PATH)/boards/rpi/fragments/linux-hardware.config"
BR2_LINUX_KERNEL_DTS_SUPPORT=y
BR2_LINUX_KERNEL_INTREE_DTS_NAME="broadcom/bcm2710-rpi-3-b-plus"

# U-Boot (rpi_arm64 = generic 64-bit RPi; works for BCM2837/Pi 3)
BR2_TARGET_UBOOT_BOARD_DEFCONFIG="rpi_arm64"
BR2_TARGET_UBOOT_CONFIG_FRAGMENT_FILES="$(BR2_EXTERNAL_OFFLINELAB_PATH)/boards/rpi/rpi3/fragments/uboot-fragment.config"

# RPi firmware
BR2_PACKAGE_RPI_FIRMWARE=y
BR2_PACKAGE_RPI_FIRMWARE_CONFIG_FILE="$(BR2_EXTERNAL_OFFLINELAB_PATH)/boards/rpi/rpi3/config.txt"
BR2_PACKAGE_RPI_FIRMWARE_CMDLINE_FILE="$(BR2_EXTERNAL_OFFLINELAB_PATH)/boards/rpi/rpi3/cmdline.txt"
BR2_PACKAGE_RPI_FIRMWARE_INSTALL_DTB_OVERLAYS=y
BR2_PACKAGE_RPI_FIRMWARE_BOOTCODE_BIN=y
BR2_PACKAGE_RPI_FIRMWARE_VARIANT_PI=y

# WiFi + BT firmware (BCM43430/BCM43455)
BR2_PACKAGE_BRCMFMAC_SDIO_FIRMWARE_RPI=y
BR2_PACKAGE_BRCMFMAC_SDIO_FIRMWARE_RPI_WIFI=y
BR2_PACKAGE_BRCMFMAC_SDIO_FIRMWARE_RPI_BT=y

# System
BR2_TARGET_GENERIC_GETTY_PORT="ttyS0"

# Post-image scripts
BR2_ROOTFS_POST_SCRIPT_ARGS="$(BR2_EXTERNAL_OFFLINELAB_PATH)/boards/rpi/rpi3 $(BR2_EXTERNAL_OFFLINELAB_PATH)/boards/rpi/hook.sh"
```

## br2-external/configs/offlinelab_rpi4_defconfig
```kconfig
################################################################################
#         ____  ___________               __          __                       #
#        / __ \/ __/ __/ (_)___  ___     / /   ____ _/ /_                      #
#       / / / / /_/ /_/ / / __ \/ _ \   / /   / __ `/ __ \                     #
#      / /_/ / __/ __/ / / / / /  __/  / /___/ /_/ / /_/ /                     #
#      \____/_/ /_/ /_/_/_/ /_/\___/  /_____/\__,_/_.___/                      #
#                                                                              #
#      Copyright (C) 2025-2026 Offline Lab                                     #
#      Contact: info@offline-lab.com                                           #
#      SPDX-License-Identifier: AGPL-3.0-only                                  #
################################################################################

# Board fragment — merged on top of offlinelab_common_defconfig by build-image.sh.
# Only board-specific settings live here.

# Architecture — Cortex-A72 aarch64 (BCM2711)
BR2_cortex_a72=y

# Kernel — RPi vendor kernel; bcm2711_defconfig is the Pi 4 defconfig
BR2_LINUX_KERNEL_CUSTOM_TARBALL=y
BR2_LINUX_KERNEL_CUSTOM_TARBALL_LOCATION="https://github.com/raspberrypi/linux/archive/refs/tags/rpi-6.12.y_20241206_2.tar.gz"
BR2_LINUX_KERNEL_USE_DEFCONFIG=y
BR2_LINUX_KERNEL_DEFCONFIG="bcm2711"
BR2_LINUX_KERNEL_CONFIG_FRAGMENT_FILES="$(BR2_EXTERNAL_OFFLINELAB_PATH)/boards/common/fragments/linux-kernel.config $(BR2_EXTERNAL_OFFLINELAB_PATH)/boards/rpi/fragments/linux-hardware.config"
BR2_LINUX_KERNEL_DTS_SUPPORT=y
BR2_LINUX_KERNEL_INTREE_DTS_NAME="broadcom/bcm2711-rpi-4-b"

# U-Boot (rpi_4 = Pi 4 specific)
BR2_TARGET_UBOOT_BOARD_DEFCONFIG="rpi_4"
BR2_TARGET_UBOOT_CONFIG_FRAGMENT_FILES="$(BR2_EXTERNAL_OFFLINELAB_PATH)/boards/rpi/rpi4/fragments/uboot-fragment.config"

# RPi firmware — both VARIANT_PI (start.elf) and VARIANT_PI4 (start4.elf) needed
BR2_PACKAGE_RPI_FIRMWARE=y
BR2_PACKAGE_RPI_FIRMWARE_CONFIG_FILE="$(BR2_EXTERNAL_OFFLINELAB_PATH)/boards/rpi/rpi4/config.txt"
BR2_PACKAGE_RPI_FIRMWARE_CMDLINE_FILE="$(BR2_EXTERNAL_OFFLINELAB_PATH)/boards/rpi/rpi4/cmdline.txt"
BR2_PACKAGE_RPI_FIRMWARE_INSTALL_DTB_OVERLAYS=y
BR2_PACKAGE_RPI_FIRMWARE_BOOTCODE_BIN=y
BR2_PACKAGE_RPI_FIRMWARE_VARIANT_PI=y
BR2_PACKAGE_RPI_FIRMWARE_VARIANT_PI4=y

# WiFi + BT firmware (BCM43455)
BR2_PACKAGE_BRCMFMAC_SDIO_FIRMWARE_RPI=y
BR2_PACKAGE_BRCMFMAC_SDIO_FIRMWARE_RPI_WIFI=y
BR2_PACKAGE_BRCMFMAC_SDIO_FIRMWARE_RPI_BT=y

# EEPROM — manages Pi 4 bootloader chip; allows OTA bootloader updates
BR2_PACKAGE_RPI_EEPROM=y

# System
BR2_TARGET_GENERIC_GETTY_PORT="ttyAMA0"

# Post-image scripts
BR2_ROOTFS_POST_SCRIPT_ARGS="$(BR2_EXTERNAL_OFFLINELAB_PATH)/boards/rpi/rpi4 $(BR2_EXTERNAL_OFFLINELAB_PATH)/boards/rpi/hook.sh"
```

## br2-external/package/appctl/Config.in
```kconfig
################################################################################
#         ____  ___________               __          __                       #
#        / __ \/ __/ __/ (_)___  ___     / /   ____ _/ /_                      #
#       / / / / /_/ /_/ / / __ \/ _ \   / /   / __ `/ __ \                     #
#      / /_/ / __/ __/ / / / / /  __/  / /___/ /_/ / /_/ /                     #
#      \____/_/ /_/ /_/_/_/ /_/\___/  /_____/\__,_/_.___/                      #
#                                                                              #
#      Copyright (C) 2025-2026 Offline Lab                                     #
#      Contact: info@offline-lab.com                                           #
#      SPDX-License-Identifier: AGPL-3.0-only                                  #
################################################################################

config BR2_PACKAGE_APPCTL
	bool "appctl"
	depends on BR2_INIT_SYSTEMD
	help
	  On-device package manager for Offline Lab OS.
	  Installs, updates, and manages portable service packages.

	  Fetches the appctl binary from appctl.git releases at build time.
	  Not yet included in any defconfig — enable when appctl.git has a
	  stable release and the hash file is updated.

	  https://github.com/offline-lab/appctl

if BR2_PACKAGE_APPCTL

config BR2_PACKAGE_APPCTL_VERSION
	string "appctl version (git tag or commit)"
	default "v0.1.0"
	help
	  Git ref to build. Use a tag (e.g. "v0.1.0") for reproducible builds.
	  Update appctl.hash with the tarball sha256 when changing this.

	  To update: change version, run appctl-dirclean, then rebuild.

endif
```

## br2-external/package/fzf/Config.in
```kconfig
################################################################################
#         ____  ___________               __          __                       #
#        / __ \/ __/ __/ (_)___  ___     / /   ____ _/ /_                      #
#       / / / / /_/ /_/ / / __ \/ _ \   / /   / __ `/ __ \                     #
#      / /_/ / __/ __/ / / / / /  __/  / /___/ /_/ / /_/ /                     #
#      \____/_/ /_/ /_/_/_/ /_/\___/  /_____/\__,_/_.___/                      #
#                                                                              #
#      Copyright (C) 2025-2026 Offline Lab                                     #
#      Contact: info@offline-lab.com                                           #
#      SPDX-License-Identifier: AGPL-3.0-only                                  #
################################################################################

config BR2_PACKAGE_FZF
	bool "fzf"
	depends on BR2_PACKAGE_BASH
	help
	  fzf is a general-purpose command-line fuzzy finder.

	  Used by boxctl (bin/tools) for interactive script browsing.
	  Installs a prebuilt static binary from the official GitHub release.

	  https://github.com/junegunn/fzf
```

## br2-external/package/offlinelab-base/Config.in
```kconfig
################################################################################
#         ____  ___________               __          __                       #
#        / __ \/ __/ __/ (_)___  ___     / /   ____ _/ /_                      #
#       / / / / /_/ /_/ / / __ \/ _ \   / /   / __ `/ __ \                     #
#      / /_/ / __/ __/ / / / / /  __/  / /___/ /_/ / /_/ /                     #
#      \____/_/ /_/ /_/_/_/ /_/\___/  /_____/\__,_/_.___/                      #
#                                                                              #
#      Copyright (C) 2025-2026 Offline Lab                                     #
#      Contact: info@offline-lab.com                                           #
#      SPDX-License-Identifier: AGPL-3.0-only                                  #
################################################################################

config BR2_PACKAGE_OFFLINELAB_BASE
	bool "offlinelab-base"
	default y
	depends on BR2_INIT_SYSTEMD
	select BR2_PACKAGE_BASH
	select BR2_PACKAGE_CA_CERTIFICATES
	select BR2_PACKAGE_COREUTILS
	select BR2_PACKAGE_E2FSPROGS
	select BR2_PACKAGE_E2FSPROGS_RESIZE2FS
	select BR2_PACKAGE_KMOD
	select BR2_PACKAGE_KMOD_TOOLS
	select BR2_PACKAGE_PARTED
	select BR2_PACKAGE_SUDO
	select BR2_PACKAGE_SYSTEMD_NETWORKD
	select BR2_PACKAGE_UTIL_LINUX
	select BR2_PACKAGE_UTIL_LINUX_BINARIES
	select BR2_PACKAGE_UTIL_LINUX_NOLOGIN
	help
	  Base system package for Offline Lab OS.
	  Installs boot-firmware mount, data partition expansion,
	  fake hardware clock, serial console, and /etc/issue.
```

## br2-external/package/offlinelab-bootconf/Config.in
```kconfig
################################################################################
#         ____  ___________               __          __                       #
#        / __ \/ __/ __/ (_)___  ___     / /   ____ _/ /_                      #
#       / / / / /_/ /_/ / / __ \/ _ \   / /   / __ `/ __ \                     #
#      / /_/ / __/ __/ / / / / /  __/  / /___/ /_/ / /_/ /                     #
#      \____/_/ /_/ /_/_/_/ /_/\___/  /_____/\__,_/_.___/                      #
#                                                                              #
#      Copyright (C) 2025-2026 Offline Lab                                     #
#      Contact: info@offline-lab.com                                           #
#      SPDX-License-Identifier: AGPL-3.0-only                                  #
################################################################################

config BR2_PACKAGE_OFFLINELAB_BOOTCONF
	bool "offlinelab-bootconf"
	depends on BR2_INIT_SYSTEMD
	select BR2_PACKAGE_SUDO
	help
	  Boot-time configuration tool. Reads /boot/firmware/bootconf.yaml
	  every boot and configures the system before other services start:
	  SSH host keys, WiFi config, sudoers, sysusers, user home dirs.

	  Replaces boxctl-startup and build-time provisioning options.

	  https://github.com/offline-lab/bootconf

if BR2_PACKAGE_OFFLINELAB_BOOTCONF

config BR2_PACKAGE_OFFLINELAB_BOOTCONF_VERSION
	string "bootconf version (git tag or commit)"
	default "v1.0.0"
	help
	  Git ref to build. Use a tag (e.g. "v1.0.0") for reproducible builds.

	  To update: change version, run offlinelab-bootconf-dirclean, rebuild.

config BR2_PACKAGE_OFFLINELAB_BOOTCONF_WIFI_CREATE
	bool "Bake WiFi credentials into bootconf.yaml.example"
	default n
	help
	  Dev/lab convenience: write SSID and password_hash into the example
	  config placed on /boot/firmware at build time.

	  Never enable on production builds.

if BR2_PACKAGE_OFFLINELAB_BOOTCONF_WIFI_CREATE

config BR2_PACKAGE_OFFLINELAB_BOOTCONF_WIFI_SSID
	string "WiFi SSID"
	default ""
	help
	  Written into bootconf.yaml.example on /boot/firmware.

config BR2_PACKAGE_OFFLINELAB_BOOTCONF_WIFI_PASSWORD_HASH
	string "WiFi password hash (from wpa_passphrase)"
	default ""
	help
	  The PSK hash from wpa_passphrase output, not the plaintext password.
	  Written into bootconf.yaml.example on /boot/firmware.

config BR2_PACKAGE_OFFLINELAB_BOOTCONF_WIFI_COUNTRY
	string "WiFi regulatory country code"
	default "NL"
	help
	  ISO 3166-1 alpha-2 country code (e.g. NL, US, GB, DE).

endif
endif
```

## br2-external/package/offlinelab-disco/Config.in
```kconfig
################################################################################
#         ____  ___________               __          __                       #
#        / __ \/ __/ __/ (_)___  ___     / /   ____ _/ /_                      #
#       / / / / /_/ /_/ / / __ \/ _ \   / /   / __ `/ __ \                     #
#      / /_/ / __/ __/ / / / / /  __/  / /___/ /_/ / /_/ /                     #
#      \____/_/ /_/ /_/_/_/ /_/\___/  /_____/\__,_/_.___/                      #
#                                                                              #
#      Copyright (C) 2025-2026 Offline Lab                                     #
#      Contact: info@offline-lab.com                                           #
#      SPDX-License-Identifier: AGPL-3.0-only                                  #
################################################################################

config BR2_PACKAGE_OFFLINELAB_DISCO
	bool "offlinelab-disco"
	depends on BR2_INIT_SYSTEMD
	depends on BR2_PACKAGE_SYSTEMD_NETWORKD
	help
	  Service discovery, NSS name resolution, and time
	  synchronization daemon for offline/airgapped networks.

	  Builds disco-daemon, disco CLI, and libnss_disco.so.2
	  from source (requires Go toolchain for cross-compilation).

	  https://github.com/offline-lab/disco

if BR2_PACKAGE_OFFLINELAB_DISCO

config BR2_PACKAGE_OFFLINELAB_DISCO_VERSION
	string "disco version (git tag or commit)"
	default "v0.20260528.1"
	help
	  Git ref to build. Use a tag (e.g. "v0.20260528.1") for
	  reproducible builds.

	  To update: change version, run offlinelab-disco-dirclean,
	  then rebuild.

endif
```

## br2-external/package/offlinelab-firewall/Config.in
```kconfig
################################################################################
#         ____  ___________               __          __                       #
#        / __ \/ __/ __/ (_)___  ___     / /   ____ _/ /_                      #
#       / / / / /_/ /_/ / / __ \/ _ \   / /   / __ `/ __ \                     #
#      / /_/ / __/ __/ / / / / /  __/  / /___/ /_/ / /_/ /                     #
#      \____/_/ /_/ /_/_/_/ /_/\___/  /_____/\__,_/_.___/                      #
#                                                                              #
#      Copyright (C) 2025-2026 Offline Lab                                     #
#      Contact: info@offline-lab.com                                           #
#      SPDX-License-Identifier: AGPL-3.0-only                                  #
################################################################################

config BR2_PACKAGE_OFFLINELAB_FIREWALL
	bool "offlinelab-firewall"
	default y
	depends on BR2_INIT_SYSTEMD
	select BR2_PACKAGE_NFTABLES
	help
	  nftables-based firewall loaded at boot via systemd.
	  Static rules (SSH, ICMP, established) live on the readonly rootfs at
	  /etc/firewall/rules.fw (inet family, covers IPv4 and IPv6).
	  Per-app dynamic rules are persisted as fragments under
	  /data/config/firewall/rules.d/<app>.rules and replayed on boot.
	  Managed at runtime via fw.sh framework module.
```
